## board/avionic-design/meerkat/Kconfig
```kconfig
if TARGET_MEERKAT

config SYS_CPU
	string
	default "arm720t" if SPL_BUILD
	default "armv7" if !SPL_BUILD

config SYS_BOARD
	string
	default "meerkat"

config SYS_VENDOR
	string
	default "avionic-design"

config SYS_SOC
	string
	default "tegra124"

config SYS_CONFIG_NAME
	string
	default "meerkat"

endif
```

## configs/meerkat_defconfig
```kconfig
CONFIG_SPL=y
CONFIG_SYS_EXTRA_OPTIONS="BOARD_MEERKAT="
+S:CONFIG_ARM=y
+S:CONFIG_TARGET_MEERKAT=y
```
